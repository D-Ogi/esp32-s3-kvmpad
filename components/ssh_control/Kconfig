## components/ssh_control/Kconfig
```kconfig
# SPDX-License-Identifier: PolyForm-Noncommercial-1.0.0
# Copyright 2026 D-Ogi. Noncommercial use only; see LICENSE.md.
# Required Notice: Copyright 2026 D-Ogi (https://github.com/D-Ogi/esp32-s3-kvmpad)
config KVM_SSH_BOARD
    bool "Paired SSH keyboard and mouse on the device"
    depends on VFS_SUPPORT_IO
    select VFS_SUPPORT_TERMIOS
    default n
    help
        Enable the direct SSH endpoint with the existing paired TLS session and
        LCD control approval. Intended for board qualification.
```

## components/ui_theme/Kconfig
```kconfig
# SPDX-License-Identifier: PolyForm-Noncommercial-1.0.0
# Copyright 2026 D-Ogi. Noncommercial use only; see LICENSE.md.
# Required Notice: Copyright 2026 D-Ogi (https://github.com/D-Ogi/esp32-s3-kvmpad)
menu "KVMpad language resources"
    config KVM_IME_KOREAN
        bool "Include the Korean keyboard module in firmware flash"
        default y
        help
            Embed the Hangul font in the application. With this option off,
            Korean composition can use font_hangul_24.bin in the ime_data
            partition. Both modes use the built-in two-set composer.
endmenu
```

## components/usb_hid_device/Kconfig
```kconfig
# SPDX-License-Identifier: PolyForm-Noncommercial-1.0.0
# Copyright 2026 D-Ogi. Noncommercial use only; see LICENSE.md.
# Required Notice: Copyright 2026 D-Ogi (https://github.com/D-Ogi/esp32-s3-kvmpad)

menu "KVMpad four-interface HID"
    depends on TINYUSB_HID_COUNT = 4
    config KVM_PTP_WIDTH_TENTH_MM
        int "Measured width of active touch region (0.1 mm, 0 = uncalibrated)"
        range 0 32767
        default 0
    config KVM_PTP_HEIGHT_TENTH_MM
        int "Measured height of active touch region (0.1 mm, 0 = uncalibrated)"
        range 0 32767
        default 0
    config KVM_HPE_JOYSTICK_QUALIFIED
        bool "Enable joystick capability for installed packs after target qualification"
        default n
        help
            Set only for a configuration verified with FLIGHT-01..04/08 and
            the Radial regression on the target. The USB report is present in
            all four-interface developer builds for qualification.
endmenu
```

## components/usb_monitor/Kconfig
```kconfig
# SPDX-License-Identifier: PolyForm-Noncommercial-1.0.0
# Copyright 2026 D-Ogi. Noncommercial use only; see LICENSE.md.
# Required Notice: Copyright 2026 D-Ogi (https://github.com/D-Ogi/esp32-s3-kvmpad)
config KVM_USB_MONITOR_EVAL
    bool "USB extended monitor evaluation profile"
    depends on KVM_UI_PLATFORM
    depends on TINYUSB_HID_COUNT = 2 || TINYUSB_HID_COUNT = 4
    default n
    help
        Start in the normal HID configuration for the selected build. The
        local USB monitor view can switch to a display-only device, and the
        USB Monitor Console can switch to a display with keyboard and mouse.
        Leaving the monitor session restores the normal HID configuration.
        Use sdkconfig.usb-monitor-eval to configure the vendor endpoints and HID control-transfer handling together.

config KVM_USB_SCREENSHOT
    bool "Enable explicit firmware screenshot storage sessions"
    depends on KVM_USB_MONITOR_EVAL
    select TINYUSB_MSC_ENABLED
    select TINYUSB_MSC_ASYNC_IO
    default n
    help
        Offers a private 32 MiB image alongside boot keyboard and mouse
        while the local screenshot session is open.

config KVM_USB_GUD
    bool "Enable explicit Linux GUD display sessions"
    depends on KVM_USB_MONITOR_EVAL
    default y
    help
        Exposes the Linux GUD display together with a boot keyboard and mouse
        on the native USB port for locally selected sessions.
        The shared test identity 1209:0001 is for private in-house use only.
        Set an allocated VID/PID for distribution. Startup uses normal HID.

if KVM_USB_GUD
config KVM_USB_GUD_VID
    hex "Authorized GUD vendor ID"
    default 0x1209
    range 0x0000 0xffff

config KVM_USB_GUD_PID
    hex "Authorized GUD product ID"
    default 0x0001
    range 0x0000 0xffff
endif
```

## test/kvmpack/card_ram/sdkconfig.defaults
```kconfig
# SPDX-License-Identifier: PolyForm-Noncommercial-1.0.0
# Copyright 2026 D-Ogi. Noncommercial use only; see LICENSE.md.
# Required Notice: Copyright 2026 D-Ogi (https://github.com/D-Ogi/esp32-s3-kvmpad)
CONFIG_APP_BUILD_TYPE_RAM=y
CONFIG_APP_BUILD_TYPE_PURE_RAM_APP=y
CONFIG_COMPILER_OPTIMIZATION_SIZE=y
CONFIG_FREERTOS_HZ=1000
CONFIG_ESP_SYSTEM_PANIC_PRINT_HALT=y
CONFIG_FATFS_USE_LABEL=y
CONFIG_FATFS_LFN_HEAP=y
CONFIG_FATFS_API_ENCODING_UTF_8=y
```
